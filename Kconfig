## Kconfig
```kconfig
mainmenu "Lanthorn Configuration"

config SRCARCH
	string
	option env="SRCARCH"
source "arch/$SRCARCH/Kconfig"

config DEBUG_INFO
	bool "Compile the application with debug info"
	default y

config NR_BUDDY_ORDER
	int
	default 21

config NR_PMM_BUDDY_SLOT_PG
	int
	default 128

config NR_KVMM_BUDDY_SLOT_PG
	int
	default 128

config SZ_PROC_NAME
	int 
	default 10
```

## arch/x86/Kconfig
```kconfig
config NR_BOOT_PTE
	int
	default 1

config NR_CPU_MAX
	int
	default 8

config NR_SEG
	int
	default 6
```
